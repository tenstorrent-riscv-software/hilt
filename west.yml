## west.yml
```yaml
manifest:
  remotes:
    - name: zephyrproject
      url-base: https://github.com/zephyrproject-rtos

  projects:
    - name: zephyr
      remote: zephyrproject
      revision: v4.5.0
      west-commands: scripts/west-commands.yml

  self:
    path: hilt
```

## zephyr/boards/tenstorrent/tt_atlantis_evb/Kconfig.tt_atlantis_evb
```kconfig
# SPDX-License-Identifier: Apache-2.0

config BOARD_TT_ATLANTIS_EVB
	select SOC_TT_ATLANTIS_RCPU if BOARD_TT_ATLANTIS_EVB_TT_ATLANTIS_RCPU
```

## zephyr/boards/tenstorrent/tt_atlantis_evb/board.yml
```yaml
board:
  name: tt_atlantis_evb
  full_name: Tenstorrent Atlantis EVB
  vendor: tenstorrent
  socs:
    - name: tt_atlantis
```

## zephyr/soc/tenstorrent/tt_atlantis/Kconfig
```kconfig
# SPDX-License-Identifier: Apache-2.0

config SOC_TT_ATLANTIS
	select RISCV
	select RISCV_PRIVILEGED
	select RISCV_SOC_HAS_GP_RELATIVE_ADDRESSING
	select HAS_POWEROFF

config SOC_TT_ATLANTIS_RCPU
	select RISCV_HAS_CLIC
	select CLIC_SMCLICCONFIG_EXT
	select LEGACY_CLIC_MEMORYMAP_ACCESS
	select INCLUDE_RESET_VECTOR
```

## zephyr/soc/tenstorrent/tt_atlantis/Kconfig.defconfig
```kconfig
# SPDX-License-Identifier: Apache-2.0

if SOC_TT_ATLANTIS_RCPU

config PMP_SLOTS
	default 16

config NUM_IRQS
	default 144

config RISCV_MCAUSE_EXCEPTION_MASK
	default 0xFFF

config CLIC_PARAMETER_INTCTLBITS
	default 4

config RISCV_HART_MASK
	default 0

config SYS_CLOCK_HW_CYCLES_PER_SEC
	default $(dt_nodelabel_int_prop,mtimer,clock-frequency)

endif # SOC_TT_ATLANTIS_RCPU
```

## zephyr/soc/tenstorrent/tt_atlantis/Kconfig.soc
```kconfig
# SPDX-License-Identifier: Apache-2.0

config SOC_TT_ATLANTIS
	bool

config SOC_TT_ATLANTIS_RCPU
	bool
	select SOC_TT_ATLANTIS

config SOC
	default "tt_atlantis" if SOC_TT_ATLANTIS
```
