/*
 * SPDX-License-Identifier: Apache-2.0
 *
 * Tenstorrent Atlantis board, RCPU cluster, on the EVB.

 * This is the HILT runtime image:
 * HILT's boot stage has already brought up the clocks, UART0 and DRAM,
 * copies this image into RCPU SRAM and jumps to its first byte.
 *
 */
/dts-v1/;
#include <tenstorrent/atlantis_rcpu.dtsi>

/ {
	model = "Tenstorrent Atlantis (RCPU)";
	compatible = "tenstorrent,atlantis";

	chosen {
		zephyr,console = &uart0;
		zephyr,shell-uart = &uart0;
		zephyr,sram = &runtime_sram;
	};

	/*
	 * Runtime window inside the RCPU SRAM: 0x20140000..0x201bffff. The image has
	 * a 512-byte simg header so the entry point actually 0x20140200.
	 */
	runtime_sram: memory@20140200 {
		device_type = "memory";
		reg = <0x20140200 (DT_SIZE_K(512) - 0x200)>;
	};
};

&uart0 {
	status = "okay";
	current-speed = <9600>;
};
